// SPDX-License-Identifier: GPL-2.0
/*
 * Copyright (C) 2018 bytes at work AG
 *
 * Based on am335x-evm.dts
 *
 * Copyright (C) 2012 Texas Instruments Incorporated - http://www.ti.com/
 */

/dts-v1/;

#include "am335x-byteengine.dtsi"
#include "am335x-bytedevkit.dtsi"

/ {
	model = "bytesatwork byteDEVKIT with byteENGINE AM335x NAND";
	compatible = "bytesatwork,byteengine-am335x", "ti,am33xx";
};

&gpmc {
	status = "okay";
};
